## conf/layer.conf
```bitbake
# We have a conf and classes directory, add to BBPATH
BBPATH .= ":${LAYERDIR}"

# We have recipes-* directories, add to BBFILES
BBFILES += "${LAYERDIR}/recipes-*/*/*.bb \
            ${LAYERDIR}/recipes-*/*/*.bbappend"

BBFILE_COLLECTIONS += "meta-gsoc-demo"
BBFILE_PATTERN_meta-gsoc-demo = "^${LAYERDIR}/"
BBFILE_PRIORITY_meta-gsoc-demo = "6"

LAYERDEPENDS_meta-gsoc-demo = "core"
LAYERDEPENDS_meta-gsoc-demo = " \
    core \
    flutter-layer \
"

LAYERSERIES_COMPAT_meta-gsoc-demo = "scarthgap"
```
